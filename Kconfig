## Kconfig
```kconfig
config ZMK_BEHAVIOR_MOD_HOLD
  bool
  default y
  depends on DT_HAS_ZMK_BEHAVIOR_MOD_HOLD_ENABLED

config ZMK_BEHAVIOR_DEAD_KEY
  bool
  default y
  depends on DT_HAS_ZMK_BEHAVIOR_DEAD_KEY_ENABLED

if SHIELD_KLOR_LEFT || SHIELD_KLOR_DONGLE 

    config ZMK_KEYBOARD_NAME
        default "KLOR2"

    config ZMK_SPLIT_BLE_ROLE_CENTRAL
        default y

    config ZMK_USB
        default y

endif

if SHIELD_KLOR_LEFT || SHIELD_KLOR_RIGHT

    config ZMK_SPLIT
        default y

endif
```
